## conf/distro/poky-wifx.conf
```bitbake
require conf/distro/poky.conf

DISTRO = "poky-wifx"
SANITY_TESTED_DISTROS += " Ubuntu-16.04"

DISTRO_FEATURES_remove ?= "opengl wayland x11 3g nfc pulseaudio alsa"
```

## conf/machine/sama5d4-lorix-one-sd.conf
```bitbake
#@TYPE: Machine
#@Name: WIFX SAMA5D4 LORIX One
#@DESCRIPTION: Machine configuration for Wifx LoRa gateway board - LORIX One

require conf/machine/include/sama5d4.inc

MACHINE_FEATURES = "kernel26 apm ext2 ext3 usbhost usbgadget ppp"
KERNEL_DEVICETREE = "at91-sama5d4_lorix_one.dtb"

ROOT_FLASH_SIZE = "256"
IMAGE_FSTYPES += " ubi tar.gz"

# NAND
MKUBIFS_ARGS = " -e 0x3e000 -c 2082 -m 0x1000 -x lzo"
UBINIZE_ARGS = " -m 0x1000 -p 0x40000"

UBI_VOLNAME = "rootfs"

UBOOT_MACHINE ?= "sama5d4_lorix_one_mmc_defconfig"
UBOOT_ENTRYPOINT = "0x20008000"
UBOOT_LOADADDRESS = "0x20008000"

AT91BOOTSTRAP_MACHINE ?= "sama5d4_lorix_one"
```
